#ifdef ZILPZALP_BLE_FLAG
#include <dt-bindings/zmk/bt.h>
#include <dt-bindings/zmk/outputs.h>
#endif

#include "base_zilpzalp.h"


// zilpzalp key numbers
//     __________________________  __________________________
//    /     0  |  1  |  2  |  3  \/   4 |   5 |   6 |   7    \
// |  8  |  9  | 10  | 11  | 12  /\  13 |  14 |  15 |  16 | 17  |
//    \    18  | 19  | 20    /        \    21 |  22 |  23   /
//          \    24  | 25  /            \  26 |  27    /
//           --------------              --------------

/ {

    keymap {
        compatible = "zmk,keymap";

        aptmak {
            label = "APT";

            bindings = <
                               &kp W          &kp F          &kp P          &kp B          &kp J          &kp L          &kp U          &kp Y
                &hl LCTRL R    &hl LALT S     &hl LGUI T     &hl LSHFT H    &hl RALT K     &hr RALT X     &hr RSHFT N    &hr RGUI A     &hr LALT I     &hr RCTRL O
                               &kp C          &kp G          &kp D                                        &kp M          &comsem        &dotcol
                                                             &my_lt NUM SQT &my_lt NAV SPACE &my_lt SYM E &my_lt FUN TAB
            >;
        };
    	game {
	   label = "GAM";

	   bindings = <
				&kp TAB       &kp W	     &kp E          &kp R          &kp M          &kp U           &kp I         &kp O
		&kp LCTRL       &kp A         &kp S          &kp D          &kp F          &kp I          &kp J         &kp K         &kp L         &kp P
		                &kp Z         &kp X          &kp V                                        &kp N1          &kp N2        &kp N3
				                             &kp W       &kp SPC        &kp N0         &kp EQUAL
	   >;
        };
        numbers {
            label = "NUM";

            bindings = <
                                  &none             &none                &none              &none          &none          &kp N7         &kp N8         &kp N9
                &hl LCTRL KP_PLUS &hl LALT KP_MINUS &hl LGUI KP_ASTERISK &hl LSHFT KP_SLASH &kp RALT       &none          &kp N4         &kp N5         &kp N6         &kp DOT
                                  &kp N9            &kp N8               &kp N7                                           &kp N1         &kp N2         &kp N3
                                                             &trans         &trans         &kp E          &kp N0
            >;
        };
        navigation {
            label = "NAV";

            bindings = <
                               &none          &none          &none           &kp C_VOL_UP   &kp LC(X)      &kp LC(INSERT) &kp LS(INSERT) &kp INSERT
                &sk LCTRL      &sk LALT       &sk LGUI       &sk LSHFT       &kp C_VOL_DN   &kp C_MUTE     &kp LEFT       &kp DOWN       &kp UP         &kp RIGHT
                               &kp HOME       &kp PG_DN      &kp END                                       &kp HOME       &kp PG_UP      &kp END
                                                             &trans          &trans         &trans         &trans
            >;
        };
        symbols {
            label = "SYM";

            bindings = <
                               &none          &none          &none            &none          &none          &none          &none          &none
                &kp EXCL       &kp AT         &kp HASH       &kp DOLLAR       &none          &none          &kp AMPERSAND  &kp ASTERISK   &kp PERCENT    &kp CARET
                               &kp GRAVE      &kp DQT        &kp UNDERSCORE                                 &kp BACKSLASH  &kp PIPE       &kp EQUAL
                                                             &kp TILDE        &trans         &trans         &trans
            >;
        };
#ifdef ZILPZALP_BLE_FLAG
        function {
            label = "FUN";

            bindings = <
                               &bt BT_SEL 0   &bt BT_SEL 1   &bt BT_CLR_ALL &bt BT_PRV     &kp F12        &kp F7         &kp F8         &kp F9
                &bootloader    &bt BT_SEL 2   &bt BT_SEL 3   &bt BT_SEL 4   &bt BT_NXT     &kp F11        &kp F4         &kp F5         &kp F6         &kp F10
                               &to GAM        &kp F8         &kp F7                                       &kp F1         &kp F2         &kp F3
                                                             &out OUT_TOG   &trans         &trans         &trans
            >;
#endif
#ifndef ZILPZALP_BLE_FLAG
        function {
            label = "FUN";

            bindings = <
                               &bootloader    &trans         &trans         &trans         &kp F12        &kp F7         &kp F8         &kp F9
                &bootloader    &kp F12        &kp F11        &kp F10        &trans         &kp F11        &kp F4         &kp F5         &kp F6         &kp F10
                               &kp F9         &kp F8         &kp F7                                       &kp F1         &kp F2         &kp F3
                                                             &trans         &trans         &trans         &trans
            >;
#endif
        };

    };
};

//     __________________________  __________________________
//    /     1  |  2  |  3  |  4  \/   5 |   6 |   7 |   8    \
// | 10  | 11  | 12  | 13  | 14  ||  15 |  16 |  17 |  18 | 19  |
//    \    20  | 21  | 22  |     ||     |  23 |  24 |  25   /
//                \    26  | 27  /\  28 |  29    /
//                 --------------  --------------
